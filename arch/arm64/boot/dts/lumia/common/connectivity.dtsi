/* Copyright (c) 2014-2015, The Linux Foundation. All rights reserved.
 *
 * This program is free software; you can redistribute it and/or modify
 * it under the terms of the GNU General Public License version 2 and
 * only version 2 as published by the Free Software Foundation.
 *
 * This program is distributed in the hope that it will be useful,
 * but WITHOUT ANY WARRANTY; without even the implied warranty of
 * MERCHANTABILITY or FITNESS FOR A PARTICULAR PURPOSE.  See the
 * GNU General Public License for more details.
 */
 
&soc {
	bt_qca6174 {
		compatible = "qca,qca6174";
		qca,bt-reset-gpio = <&pm8994_gpios 19 0>; /* BT_EN */
		qca,bt-vdd-pa-supply = <&bt_vreg>;
		qca,bt-vdd-io-supply = <&pm8994_s4>;
		qca,bt-vdd-xtal-supply = <&pm8994_l30>;
		qca,bt-vdd-io-voltage-level = <1800000 1800000>;
		qca,bt-vdd-xtal-voltage-level = <1800000 1800000>;
	};
};


    //Use pn544 for now since there does not exist a driver for pn547
	&i2c_6 {
		status = "okay";
		
		qcom,disable-dma;
		pn547@28 { /* NFC */
			compatible = "nxp,pn547";
			status = "ok";
			reg = <0x28>;
			interrupt-parent = <&msm_gpio>;
			interrupts = <29 0x1>;
			nxp,irq_gpio = <&msm_gpio 29 0x00>;
			nxp,dwld_en = <&msm_gpio 94 0x00>;
			nxp,ven = <&msm_gpio 30 0x00>;
			qcom,clk-src = "BBCLK2";
			qcom,clk-gpio = <&msm_gpio 10 0>;
			clocks = <&clock_rpm clk_bb_clk2_pin>;
			clock-names = "nfc_clk";

			interrupt-names = "nfc_irq";
			pinctrl-names = "nfc_active","nfc_suspend";
			pinctrl-0 = <&nfc_int_active &nfc_disable_active>;
			pinctrl-1 = <&nfc_int_suspend &nfc_disable_suspend>;
		};
		
	};	

